## kbd/zmk-dynamic-pinctl-spi/config/west.yml
```yaml
manifest:
  projects:
    - name: zmk
      remote: zmkfirmware
      revision: main
      import: app/west.yml
    - name: zmk-dynamic-pinctl-spi
      remote: hidsh
      revision: main
  self:
    path: config
```

## kbd/zmk-dynamic-pinctl-spi/zmk-modules/zmk-analog-input-driver/dts/bindings/zmk,analog-input.yaml
```yaml
# Copyright (c) 2022 The ZMK Contributors
# SPDX-License-Identifier: MIT
description: |
  Input driver for ADC io channel

compatible: "zmk,analog-input"

properties:
  sampling-hz:
    type: int
    default: 100
  
  adc-mcp320x-vref-mv:
    type: int
    default: 0
    description: |
      Reference voltage in millivolts for the MCP3204/MCP3208 controller.
      Must be >= 0 and <= 0x7FFFFFFF.
      (Adopted from zmk/zephyr/dts/bindings/adc/adc-controller.yaml)

child-binding:
  description: Per-channel configuration settings
  properties:
    io-channels:
      type: phandle-array
      required: true
    mv-mid:
      type: int
      required: true
    mv-min-max:
      type: int
      required: true
    mv-deadzone:
      type: int
      default: 10
    invert:
      type: boolean
    report-on-change-only:
      type: boolean
    scale-multiplier:
      type: int
      default: 1
    scale-divisor:
      type: int
      default: 70
    evt-type:
      type: int
      required: true
    input-code:
      type: int
      required: true
```

## zmk/app/build/Kconfig/Kconfig.shield
```kconfig
osource "/home/g/mise-work/zmk-firmware/zmk/app/boards/shields/*/Kconfig.shield"
osource "/home/g/mise-work/zmk-firmware/kbd/zmk-dynamic-pinctl-spi/config/boards/shields/*/Kconfig.shield"
```
